## conf/layer.conf
```bitbake
# We have a conf and classes directory, add to BBPATH
BBPATH .= ":${LAYERDIR}"

# We have recipes-* directories, add to BBFILES
BBFILES += "${LAYERDIR}/recipes-*/*/*.bb \
            ${LAYERDIR}/recipes-*/*/*.bbappend"

BBFILE_COLLECTIONS += "meta-raspi-zero-cfg"
BBFILE_PATTERN_meta-raspi-zero-cfg = "^${LAYERDIR}/"
BBFILE_PRIORITY_meta-raspi-zero-cfg = "16"

LAYERDEPENDS_meta-raspi-zero-cfg = "core"
LAYERSERIES_COMPAT_meta-raspi-zero-cfg = "thud"
```
